## meta-bsp/conf/machine/raspberrypi1.conf
```bitbake
#@TYPE: Machine
#@NAME: RaspberryPi 1 Development Board
#@DESCRIPTION: Machine configuration for the RaspberryPi 1

DEFAULTTUNE = "arm1176jzs"

require conf/machine/include/tune-arm1176jz-s.inc
require conf/machine/include/rpi-base.inc

SERIAL_CONSOLES = "-l;/sbin/autologin;-n;115200;ttyAMA0 -l;/sbin/autologin;-n;38400;tty1"
USE_VT = "0"

UBOOT_MACHINE = "rpi_1_config"

KERNEL_CONFIG = "bcm2835_defconfig"

RPI_KERNEL_DEVICETREE_DTB = " \
    bcm2835-rpi-b.dtb \
    bcm2835-rpi-b-plus.dtb \
    bcm2835-rpi-zero.dtb \
    bcm2835-rpi-zero-w.dtb \
"

RPI_KERNEL_DEVICETREE_OVERLAYS += " \
    overlays/disable-bt.dtbo \
    overlays/miniuart-bt.dtbo \
"
```
